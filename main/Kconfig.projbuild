## main/Kconfig.projbuild
```kconfig
menu "Project Configuration"

    config SSID
        string "SSID"
        default ""
        help
            The Wi-Fi SSID for the ESP32 to connect to.

    config PASSWORD
        string "Password"
        default ""
        help
            The Wi-Fi password for the ESP32 to connect to.

    config OTA_URL
        string "OTA URL"
        default "https://example/firmware"
        help
            The default OTA firmware URL.

    config FIRMWARE_VERSION_ENDPOINT
        string "VERSION URL"
        default "https://example/version"
        help
            The default firmware version JSON endpoint.

    config WIFI_RETRIES
        int "Wifi retries"
        default 100
        help
            Amount of retries for connecting to wifi before failure.

    config AP_SSID
        string "AP SSID"
        default ""
        help
            The Wi-Fi SSID for the ESP32 in AP mode.

    config AP_PASSWORD
        string "AP Password"
        default ""
        help
            The Wi-Fi password for the ESP32 in AP mode.

    config ESP_NAME
        string "ESP Name"
        default "ESP-IDF-BOILERPLATE"
        help
            The name of the ESP Unit. This can be removed as it used for demonstration purposes

    config MAX_ESP_NAME_LEN
        int "Max ESP Name Length"
        range 1 255
        default 100
        help
            Maximum allowed length for the unit name in characters

endmenu
```
